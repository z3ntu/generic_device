## configs/castor_defconfig
```kconfig
CONFIG_ARCH_ARM=y
CONFIG_PRODUCT_DEVICE="castor"
CONFIG_TREBLE=y
CONFIG_DALVIK_VM_HEAPSIZE=760
CONFIG_DALVIK_VM_HEAPGROWTHLIMIT=250
CONFIG_BOARD_SYSTEMIMAGE_PARTITION_SIZE=1288491008
CONFIG_SEPARATE_VENDOR_IMAGE=y
CONFIG_BOARD_USERDATAIMAGE_PARTITION_SIZE=5653544960
CONFIG_DEX_PREOPT=y
CONFIG_FIRMWARE=y
CONFIG_FIRMWARE_FILES="qcom/a330_pfp.fw,qcom/a330_pm4.fw,brcm/brcmfmac4339-sdio.bin,brcm/brcmfmac4339-sdio.txt"
CONFIG_DISPLAY_DPI=240
CONFIG_BLUETOOTH=y
CONFIG_BOARD_WLAN_DEVICE="qcwcn"
# CONFIG_ETHERNET is not set
```
